const int segPins[] = {13, 12, 14, 27, 26, 25, 33}; 
const byte numCodes[10] = {0x3F,0x06,0x5B,0x4F,0x66,0x6D,0x7D,0x07,0x7F,0x6F};

#define BUZZER_PIN 18
int melody[] = {330, 330, 330, 262, 330, 392};
int noteDurations[] = {8,4,4,8,4,2};


#define KEY_PIN 19
bool deviceState = false;
bool lastKeyState = HIGH;

#define COVER_PIN 5  
bool lastCoverState = HIGH;

#include <Adafruit_GFX.h>
#include <Adafruit_SSD1306.h>
#define SCREEN_I2C_ADDR 0x3C   
#define SCREEN_WIDTH 128
#define SCREEN_HEIGHT 64
#define OLED_RST_PIN -1
Adafruit_SSD1306 display(SCREEN_WIDTH, SCREEN_HEIGHT, &Wire, OLED_RST_PIN);

#define FRAME_DELAY (42)
#define FRAME_WIDTH (32)
#define FRAME_HEIGHT (32)
#define FRAME_COUNT (sizeof(frames) / sizeof(frames[0]))
const byte PROGMEM frames[][128] = {
  {0,0,0,0,7,128,3,192,15,192,7,240,24,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0,0},
  {0,0,0,0,7,128,3,192,15,192,7,240,24,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0,0},
  {0,0,0,0,7,128,3,192,15,192,7,240,24,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0,0},
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  {0,0,0,0,7,128,3,192,15,192,7,240,24,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0,0}
};

// ===================== 爱心动画数据 =====================
#define HEART_FRAME_DELAY 45
#define HEART_FRAME_WIDTH 32
#define HEART_FRAME_HEIGHT 32
#define HEART_FRAME_COUNT (sizeof(heartFrames) / sizeof(heartFrames[0]))

const byte PROGMEM heartFrames[][128] = {
  {0,0,0,0,0,0,0,0,0,0,0,0,0,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0,0},
  {0,0,0,0,0,0,0,0,0,0,0,0,0,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0,0},
  {0,0,0,0,0,0,0,0,0,0,0,0,0,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0,0},
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  {0,0,0,0,0,0,0,0,0,0,0,0,0,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0,0}
};

// ===================== 核心功能：闹钟动画+蜂鸣器同步联动 =====================
void playAlarmAnimation() {
  int frame = 0;
  // 播放完整闹钟动画 + 蜂鸣器同步报警
  for(frame=0; frame<FRAME_COUNT; frame++){
    display.clearDisplay();
    display.drawBitmap(48, 16, frames[frame], FRAME_WIDTH, FRAME_HEIGHT, 1);
    display.display();
    tone(BUZZER_PIN, 4000); // 蜂鸣器高频报警音
    delay(FRAME_DELAY);
  }
  noTone(BUZZER_PIN); // 动画结束停止蜂鸣器

  // 报警结束显示四方格药盒（左上格高亮），保持 10 秒
  drawPillBox(0);
  delay(10000);
}

// ===================== 四方格药盒（均匀分布，指定格高亮） =====================
void drawPillBox(int boxIndex) {
  display.clearDisplay();
  display.setTextSize(1); // 复位文字尺寸，避免影响后续显示

  int size = 28;
  int gap  = 10;
  int startX = (SCREEN_WIDTH  - (size * 2 + gap)) / 2;
  int startY = (SCREEN_HEIGHT - (size * 2 + gap)) / 2;

  for (int row = 0; row < 2; row++) {
    for (int col = 0; col < 2; col++) {
      int x = startX + col * (size + gap);
      int y = startY + row * (size + gap);
      int idx = row * 2 + col; // 0=左上, 1=右上, 2=左下, 3=右下

      if (idx == boxIndex)
        display.fillRect(x, y, size, size, WHITE);
      else
        display.drawRect(x, y, size, size, WHITE);
    }
  }
  display.display();
}

// ===================== 爱心动画 + 蜂鸣器 =====================
// ===================== 马里奥音符结构体（用于爱心动画并行播放） =====================
struct Note {
  int freq;
  int duration; // ms
};

Note marioNotes[] = {
  {330, 150},
  {330, 300},
  {330, 300},
  {262, 150},
  {330, 300},
  {392, 600}
};

const int NOTE_COUNT = sizeof(marioNotes) / sizeof(marioNotes[0]);

// ===================== 爱心动画 + 马里奥音乐（并行） =====================
void playHeartAnimation() {
  int currentFrame = 0;
  int noteIndex = 0;

  unsigned long lastFrameTime = millis();
  unsigned long noteStartTime = millis();

  // 起始播放第一个音符
  tone(BUZZER_PIN, marioNotes[0].freq);

  while (noteIndex < NOTE_COUNT) {
    unsigned long now = millis();

    // ----- 切换到下一个音符 -----
    if (now - noteStartTime >= (unsigned long)marioNotes[noteIndex].duration) {
      noTone(BUZZER_PIN);
      noteIndex++;
      if (noteIndex < NOTE_COUNT) {
        tone(BUZZER_PIN, marioNotes[noteIndex].freq);
        noteStartTime = now;
      }
    }

    // ----- 刷新爱心动画帧 -----
    if (now - lastFrameTime >= HEART_FRAME_DELAY) {
      display.clearDisplay();
      display.drawBitmap(
        48, 16,
        heartFrames[currentFrame],
        HEART_FRAME_WIDTH,
        HEART_FRAME_HEIGHT,
        1
      );
      display.display();

      currentFrame = (currentFrame + 1) % HEART_FRAME_COUNT;
      lastFrameTime = now;
    }

    yield(); // 防止 watchdog
  }

  noTone(BUZZER_PIN);
}

// ===================== 原版功能函数（100%保留） =====================
void playSuperMario() {
  int totalNotes = sizeof(melody) / sizeof(melody[0]);
  for (int i = 0; i < totalNotes; i++) {
    int noteDuration = 800 / noteDurations[i];
    tone(BUZZER_PIN, melody[i]);
    delay(noteDuration * 1.3);
    noTone(BUZZER_PIN);
    delay(50);
  }
}

void displayNumber(int num) {
  byte code = numCodes[num];
  for (int i = 0; i < 7; i++) {
    digitalWrite(segPins[i], bitRead(code, i));
  }
}

// ===================== 初始化 =====================
void setup() {
  // 硬件初始化
  for (int i = 0; i < 7; i++) pinMode(segPins[i], OUTPUT);
  pinMode(BUZZER_PIN, OUTPUT);
  pinMode(KEY_PIN, INPUT_PULLUP);
  pinMode(COVER_PIN, INPUT_PULLUP);
  lastCoverState = digitalRead(COVER_PIN);

  // OLED初始化
  display.begin(SSD1306_SWITCHCAPVCC, SCREEN_I2C_ADDR);
  display.clearDisplay();
  display.setTextSize(1);
  display.setTextColor(WHITE);
  display.setCursor(25, 20);
  display.println("How are You?");
  display.display();
}

// ===================== 主逻辑 =====================
void loop() {
  bool currentKeyState = digitalRead(KEY_PIN);
  bool currentCoverState = digitalRead(COVER_PIN);
  displayNumber(deviceState ? 8 : 0);

  // 1. 按键自锁：按下按键 → 触发闹钟动画+蜂鸣器报警
  if (currentKeyState == LOW && lastKeyState == HIGH) {
    delay(20);
    deviceState = !deviceState;
        if(deviceState){
      playAlarmAnimation();     // 第一次：闹钟
    }else{
      playHeartAnimation();    // 第二次：爱心动画

      // 回到待机界面
      display.clearDisplay();
      display.setTextSize(1);
      display.setCursor(25, 20);
      display.println("Have a good day");
      display.display();
    }
  }

  // 2. 合盖触发：爱心动画 + 蜂鸣器（真实动画）
if (currentCoverState == LOW && lastCoverState == HIGH) {
  delay(20);
  playHeartAnimation();   // 💖 播放爱心动画 + 心跳音
}

  lastKeyState = currentKeyState;
  lastCoverState = currentCoverState;
  delay(50);
}

